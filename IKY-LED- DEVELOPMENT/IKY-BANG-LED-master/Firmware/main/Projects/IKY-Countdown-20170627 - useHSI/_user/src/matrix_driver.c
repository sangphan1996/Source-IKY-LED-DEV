#include "stm32f10x.h"
#include "matrix_driver.h"
#include <string.h>
#include "logger.h"
#include "system_config.h"
#include "sys_tick.h"

#define MT_SCAN_DELAY				20

void MaTrix_Column_Select(uint8_t Col);
void MaTrix_VRam_Update(void);
//
LEDMatrix_Typedef LEDMatrix;
const uint8_t Row_Code[] =
{
0x00,
0x04,0x02,0x08,0x01,0x40,0x10,0x80,0x20
};

const uint8_t MaTrix_Column_Code[][6] =
{
{0x00,0x00,0x00,0x00,0x00,0x00}, //0

{0x00,0x00,0x00,0x00,0x00,0x20}, //48
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{0x80,0x00,0x00,0x00,0x00,0x00}, //1
};

const uint8_t MaTrix_Code_Table[97][6]={
              0x00,0x00,0x00,0x00,0x00,0x00,//  SPACE 0
              0x00,0x00,0x3D,0x00,0x00,0x00,//  ! 1
              0xFF,0xFF,0xF8,0xF4,0xFF,0xFF,//  ' 2
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              0x00,0x00,0x00,0x00,0x00,0x00,//  BLANK CHAR 96
};



uint8_t MaTrix_Row_Code_Convert(uint8_t Data)
{
	uint8_t i;
	uint8_t rs = 0;
	//
	for(i=0;i<8;i++) {	
		if ((Data >> i) & 0x01)
				rs |= Row_Code[i+1];	
	}
	#if(MATRIX_CELL_ON)
	return (rs);
	#else
	return (~rs);
	#endif
}	

void MT_Delay(uint32_t nTime)
{ 
	while(nTime--);
}

void TIMER3_Init(void)
{
	TIM_TimeBaseInitTypeDef TIM_TimeBaseStructure;
	NVIC_InitTypeDef NVIC_InitStructure;
  TIM_DeInit(TIM3);
  TIM_TimeBaseStructInit(&TIM_TimeBaseStructure);
    /* TIM5 clock enable */
  RCC_APB1PeriphClockCmd(RCC_APB1Periph_TIM3, ENABLE);
  /* Time base configuration */
  TIM_TimeBaseStructure.TIM_Prescaler = 1200 - 1; // 48 MHz / 1200 = 40 KHz
  TIM_TimeBaseStructure.TIM_Period = 17 - 1;  // 40 KHz / 20 = 2 KHz;
  TIM_TimeBaseStructure.TIM_ClockDivision = 0;
  TIM_TimeBaseStructure.TIM_CounterMode = TIM_CounterMode_Up;
  TIM_TimeBaseInit(TIM3, &TIM_TimeBaseStructure);
    
  TIM_Cmd(TIM3, ENABLE);	
	TIM_ClearITPendingBit(TIM3, TIM_IT_Update);  
  TIM_ITConfig(TIM3, TIM_IT_Update, ENABLE);
      
  NVIC_InitStructure.NVIC_IRQChannel = TIM3_IRQn;
  NVIC_InitStructure.NVIC_IRQChannelPreemptionPriority = 1;
  NVIC_InitStructure.NVIC_IRQChannelSubPriority = 1;
  NVIC_InitStructure.NVIC_IRQChannelCmd = ENABLE;
  NVIC_Init(&NVIC_InitStructure);
}

void MaTrix_IOInit(void)
{
	GPIO_InitTypeDef GPIO_InitStructure;
	
	GPIO_InitStructure.GPIO_Pin = LED_MATRIX_COL_LATCH_PIN;
	GPIO_InitStructure.GPIO_Speed = GPIO_Speed_10MHz;
	GPIO_InitStructure.GPIO_Mode = GPIO_Mode_Out_PP; 
	GPIO_Init( LED_MATRIX_COL_LATCH_PORT, &GPIO_InitStructure );
	
	GPIO_InitStructure.GPIO_Pin = LED_MATRIX_COL_DAT_PIN; 
	GPIO_Init( LED_MATRIX_COL_DAT_PORT, &GPIO_InitStructure );
	
	GPIO_InitStructure.GPIO_Pin = LED_MATRIX_COL_CLK_PIN;
	GPIO_Init( LED_MATRIX_COL_CLK_PORT, &GPIO_InitStructure );

	GPIO_InitStructure.GPIO_Pin = LED_MATRIX_COL_RESET_PIN;
	GPIO_Init( LED_MATRIX_COL_RESET_PORT, &GPIO_InitStructure );
	//Row	
	GPIO_InitStructure.GPIO_Pin = LED_MATRIX_ROW_CLK_PIN; 
	GPIO_Init( LED_MATRIX_ROW_CLK_PORT, &GPIO_InitStructure );
	
	GPIO_InitStructure.GPIO_Pin = LED_MATRIX_ROW_LATCH_PIN; 
	GPIO_Init( LED_MATRIX_ROW_LATCH_PORT, &GPIO_InitStructure );
	
	GPIO_InitStructure.GPIO_Pin = LED_MATRIX_ROW_DAT_PIN; 
	GPIO_Init( LED_MATRIX_ROW_DAT_PORT, &GPIO_InitStructure );
	
	GPIO_InitStructure.GPIO_Pin = LED_MATRIX_ROW_RESET_PIN; 
	GPIO_Init( LED_MATRIX_ROW_RESET_PORT, &GPIO_InitStructure );
	//
	GPIO_ResetBits(LED_MATRIX_COL_RESET_PORT,LED_MATRIX_COL_RESET_PIN);
	//
	GPIO_ResetBits(LED_MATRIX_ROW_RESET_PORT,LED_MATRIX_ROW_RESET_PIN);
	//	
	MaTrix_Row_WriteData(0);
	MaTrix_Column_Select(0);
	//
	TIMER3_Init();
}

void MaTrix_StringUpdate(uint8_t * newString,uint8_t len)
{	
	if(len >= sizeof(LEDMatrix.buffer_1)) return;
	memset(sysCfg.GuestInf,0,sizeof(sysCfg.GuestInf));
	memcpy(sysCfg.GuestInf,newString,len);
	strcat((char*)sysCfg.GuestInf,GFX_STRING_SPACING);	
	saveConfigFlag = 1;	
}

void MaTrix_Column_Clear(void)
{
	GPIO_SetBits(LED_MATRIX_COL_RESET_PORT,LED_MATRIX_COL_RESET_PIN);
	GPIO_ResetBits(LED_MATRIX_COL_CLK_PORT,LED_MATRIX_COL_CLK_PIN);
	MT_Delay(MT_SCAN_DELAY);
	GPIO_SetBits(LED_MATRIX_COL_CLK_PORT,LED_MATRIX_COL_CLK_PIN);	
	MT_Delay(MT_SCAN_DELAY);
	GPIO_ResetBits(LED_MATRIX_COL_LATCH_PORT,LED_MATRIX_COL_LATCH_PIN);	
	MT_Delay(MT_SCAN_DELAY);
	GPIO_SetBits(LED_MATRIX_COL_LATCH_PORT,LED_MATRIX_COL_LATCH_PIN);
	GPIO_ResetBits(LED_MATRIX_COL_RESET_PORT,LED_MATRIX_COL_RESET_PIN);	
}

void MaTrix_Row_WriteData(uint8_t Data)
{
	uint8_t i;
	for(i=0;i<8;i++) 
	{
		if ((Data >> i) & 0x01)
				GPIO_ResetBits(LED_MATRIX_ROW_DAT_PORT,LED_MATRIX_ROW_DAT_PIN);				
		else 
				GPIO_SetBits(LED_MATRIX_ROW_DAT_PORT,LED_MATRIX_ROW_DAT_PIN);
		//
		GPIO_ResetBits(LED_MATRIX_ROW_CLK_PORT,LED_MATRIX_ROW_CLK_PIN);
		MT_Delay(MT_SCAN_DELAY);
		GPIO_SetBits(LED_MATRIX_ROW_CLK_PORT,LED_MATRIX_ROW_CLK_PIN);
	}
	GPIO_ResetBits(LED_MATRIX_ROW_LATCH_PORT,LED_MATRIX_ROW_LATCH_PIN);
	MT_Delay(MT_SCAN_DELAY);
	GPIO_SetBits(LED_MATRIX_ROW_LATCH_PORT,LED_MATRIX_ROW_LATCH_PIN);
}	

void MaTrix_Column_WriteData(uint8_t *Data)
{
	uint8_t i=0,j=0;
	for(j=0;j<MATRIX_8x8_NUM;j++)
	{
		for(i=0;i<8;i++)
		{
			if ((Data[j] >> i) & 0x01)
				GPIO_ResetBits(LED_MATRIX_COL_DAT_PORT,LED_MATRIX_COL_DAT_PIN);				
			else
				GPIO_SetBits(LED_MATRIX_COL_DAT_PORT,LED_MATRIX_COL_DAT_PIN);
			//
			GPIO_ResetBits(LED_MATRIX_COL_CLK_PORT,LED_MATRIX_COL_CLK_PIN);
			MT_Delay(MT_SCAN_DELAY);
			GPIO_SetBits(LED_MATRIX_COL_CLK_PORT,LED_MATRIX_COL_CLK_PIN);
		}
	}
	GPIO_ResetBits(LED_MATRIX_COL_LATCH_PORT,LED_MATRIX_COL_LATCH_PIN);	
	MT_Delay(MT_SCAN_DELAY);
	GPIO_SetBits(LED_MATRIX_COL_LATCH_PORT,LED_MATRIX_COL_LATCH_PIN);
}

void MaTrix_Column_Select(uint8_t Col)
{
	MaTrix_Column_WriteData((uint8_t*)&MaTrix_Column_Code[Col][0]);
}

void MaTrix_VRam_Update(void)
{
  uint8_t i;
  uint8_t u8Code;
  uint8_t selFont;
  uint8_t colFont;
  //
  for(i=0; i<(MATRIX_8x8_NUM*8); i++)
  {
    selFont = LEDMatrix.buffer_1[((i+LEDMatrix.column_pos)%LEDMatrix.strlen)/WIDTH_OF_FONT]- ' ';
    colFont = (i+LEDMatrix.column_pos)%WIDTH_OF_FONT;
    u8Code = MaTrix_Code_Table[selFont][colFont];
    //        
    LEDMatrix.dram_2[i] = MaTrix_Row_Code_Convert(u8Code);    
  }
	__disable_irq();
  memcpy(LEDMatrix.dram_1,LEDMatrix.dram_2,sizeof(LEDMatrix.dram_1));
	__enable_irq();
}



void MaTrix_Scan(void)
{
	static uint8_t u8Index1 = 0;
	if(LEDMatrix.enable == 0)
	{
		u8Index1 = 0;
		LEDMatrix.column_shift = 0;
		LEDMatrix.column_pos = 0;		
		return;
	}
	MaTrix_Column_Clear();
	MaTrix_Row_WriteData(LEDMatrix.dram_1[u8Index1]);
	MaTrix_Column_Select(u8Index1+1);
	u8Index1 ++;
	if(u8Index1 >= (MATRIX_8x8_NUM*8))
	{
		u8Index1 = 0;
	}
}

void MaTrix_ColPos_Callback(void)
{
	if(LEDMatrix.effect == 0)
	{
		LEDMatrix.column_shift = 0;
		LEDMatrix.column_pos = 0;
		return;
	}
	LEDMatrix.column_shift++;
	if((LEDMatrix.column_shift % 150) == 0)
	{
		LEDMatrix.column_pos++;
		if(LEDMatrix.column_pos >= LEDMatrix.strlen)
		{
			LEDMatrix.column_pos = 0;
		}		
		MaTrix_VRam_Update();
	}
}

void TIM3_IRQHandler(void)
{
	if (TIM_GetITStatus(TIM3, TIM_IT_Update) != RESET)
	{
		MaTrix_Scan();
		TIM_ClearITPendingBit(TIM3, TIM_IT_Update);
	}
}
/*******************************************************************************
	*END FILE
********************************************************************************/
